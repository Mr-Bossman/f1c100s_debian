## configs/uboot_defconfig
```kconfig
CONFIG_ARM=y
CONFIG_ARCH_SUNXI=y
CONFIG_MACH_SUNIV=y
CONFIG_DRAM_CLK=156
CONFIG_DRAM_ZQ=0
# CONFIG_VIDEO_SUNXI is not set
CONFIG_DEFAULT_DEVICE_TREE="f1c100s_uboot"
CONFIG_BOOTDELAY=3
CONFIG_SPL=y
# CONFIG_SPL_DM_SERIAL is not set
CONFIG_DM_SPI=y
CONFIG_SUN6I_SPI=y
```
